// @generated by hardroxide. Do not edit; regenerate from the XSA.
//
// Exposes each PL interrupt as a UIO device (one node per interrupt line).
// Requires: a kernel with uio_pdrv_genirq and `uio_pdrv_genirq.of_id=generic-uio`
// on the command line, and a base device tree built with symbols (for &intc).
// Zynq-7000 mapping: IRQ_F2P[7:0] -> SPI cell 29..=36, [15:8] -> 52..=59.
// UNVERIFIED on hardware; see docs/08-verification-gaps.md (G11).
/dts-v1/;
/plugin/;

/ {
	fragment@0 {
		target-path = "/";
		__overlay__ {
			axi_dma_0_mm2s_introut@40400000 {
				compatible = "generic-uio";
				reg = <0x40400000 0x10000>;
				interrupt-parent = <&intc>;
				interrupts = <0 29 4>;
			};
			axi_dma_0_s2mm_introut@40400000 {
				compatible = "generic-uio";
				reg = <0x40400000 0x10000>;
				interrupt-parent = <&intc>;
				interrupts = <0 30 4>;
			};
		};
	};
};
