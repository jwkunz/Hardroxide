// @generated by hardroxide. Do not edit; regenerate from the XSA.
//
// Exposes each PL interrupt as a UIO device (one node per interrupt line).
// Requires: a kernel with uio_pdrv_genirq and `uio_pdrv_genirq.of_id=generic-uio`
// on the command line, and a base device tree built with symbols (for &intc).
// Zynq-7000 mapping: IRQ_F2P[7:0] -> SPI cell 29..=36, [15:8] -> 52..=59.
// UNVERIFIED on hardware; see docs/08-verification-gaps.md (G11).
// axi_gpio_0.ip2intc_irpt: input 2 of axi_intc_0; served by that controller's own interrupt
// axi_iic_0.iic2intc_irpt: input 1 of axi_intc_0; served by that controller's own interrupt
// axi_timer_0.interrupt: input 0 of axi_intc_0; served by that controller's own interrupt
/dts-v1/;
/plugin/;

/ {
	fragment@0 {
		target-path = "/";
		__overlay__ {
			axi_intc_0_irq@41800000 {
				compatible = "generic-uio";
				reg = <0x41800000 0x10000>;
				interrupt-parent = <&intc>;
				interrupts = <0 29 4>;
			};
		};
	};
};
